## Firmware/Amon_board_firmware-STM32H743-RPi_CM4/Zephyr/AmonLander/build/Kconfig/Kconfig.modules
```kconfig
ZEPHYR_ACPICA_MODULE_DIR := /workspace/modules/lib/acpica
menu "acpica (/workspace/modules/lib/acpica)"
osource "$(ZEPHYR_ACPICA_KCONFIG)"
config ZEPHYR_ACPICA_MODULE
	bool
	default y
endmenu
ZEPHYR_CMSIS_MODULE_DIR := /workspace/modules/hal/cmsis
menu "cmsis (/workspace/modules/hal/cmsis)"
osource "$(ZEPHYR_CMSIS_KCONFIG)"
config ZEPHYR_CMSIS_MODULE
	bool
	default y
endmenu
ZEPHYR_CMSIS_DSP_MODULE_DIR := /workspace/modules/lib/cmsis-dsp
menu "cmsis-dsp (/workspace/modules/lib/cmsis-dsp)"
osource "$(ZEPHYR_CMSIS_DSP_KCONFIG)"
config ZEPHYR_CMSIS_DSP_MODULE
	bool
	default y
endmenu
ZEPHYR_CMSIS_NN_MODULE_DIR := /workspace/modules/lib/cmsis-nn
menu "cmsis-nn (/workspace/modules/lib/cmsis-nn)"
osource "$(ZEPHYR_CMSIS_NN_KCONFIG)"
config ZEPHYR_CMSIS_NN_MODULE
	bool
	default y
endmenu
ZEPHYR_CMSIS_6_MODULE_DIR := /workspace/modules/hal/cmsis_6
menu "cmsis_6 (/workspace/modules/hal/cmsis_6)"
osource "$(ZEPHYR_CMSIS_6_KCONFIG)"
config ZEPHYR_CMSIS_6_MODULE
	bool
	default y
endmenu
ZEPHYR_FATFS_MODULE_DIR := /workspace/modules/fs/fatfs
menu "fatfs (/workspace/modules/fs/fatfs)"
osource "$(ZEPHYR_FATFS_KCONFIG)"
config ZEPHYR_FATFS_MODULE
	bool
	default y
endmenu
ZEPHYR_ADI_MODULE_DIR := /workspace/modules/hal/adi
config ZEPHYR_ADI_MODULE
	bool
	default y
ZEPHYR_HAL_AFBR_MODULE_DIR := /workspace/modules/hal/afbr
menu "hal_afbr (/workspace/modules/hal/afbr)"
osource "$(ZEPHYR_HAL_AFBR_KCONFIG)"
config ZEPHYR_HAL_AFBR_MODULE
	bool
	default y

config ZEPHYR_HAL_AFBR_MODULE_BLOBS
	bool
endmenu
ZEPHYR_HAL_AMBIQ_MODULE_DIR := /workspace/modules/hal/ambiq
menu "hal_ambiq (/workspace/modules/hal/ambiq)"
osource "$(ZEPHYR_HAL_AMBIQ_KCONFIG)"
config ZEPHYR_HAL_AMBIQ_MODULE
	bool
	default y
endmenu
ZEPHYR_ATMEL_MODULE_DIR := /workspace/modules/hal/atmel
config ZEPHYR_ATMEL_MODULE
	bool
	default y
ZEPHYR_HAL_BOUFFALOLAB_MODULE_DIR := /workspace/modules/hal/bouffalolab
menu "hal_bouffalolab (/workspace/modules/hal/bouffalolab)"
osource "$(ZEPHYR_HAL_BOUFFALOLAB_KCONFIG)"
config ZEPHYR_HAL_BOUFFALOLAB_MODULE
	bool
	default y
endmenu
ZEPHYR_HAL_ESPRESSIF_MODULE_DIR := /workspace/modules/hal/espressif
menu "hal_espressif (/workspace/modules/hal/espressif)"
osource "/workspace/modules/hal/espressif/zephyr/Kconfig"
config ZEPHYR_HAL_ESPRESSIF_MODULE
	bool
	default y

config ZEPHYR_HAL_ESPRESSIF_MODULE_BLOBS
	bool
endmenu
ZEPHYR_HAL_ETHOS_U_MODULE_DIR := /workspace/modules/hal/ethos_u
menu "hal_ethos_u (/workspace/modules/hal/ethos_u)"
osource "$(ZEPHYR_HAL_ETHOS_U_KCONFIG)"
config ZEPHYR_HAL_ETHOS_U_MODULE
	bool
	default y
endmenu
ZEPHYR_HAL_GIGADEVICE_MODULE_DIR := /workspace/modules/hal/gigadevice
menu "hal_gigadevice (/workspace/modules/hal/gigadevice)"
osource "$(ZEPHYR_HAL_GIGADEVICE_KCONFIG)"
config ZEPHYR_HAL_GIGADEVICE_MODULE
	bool
	default y
endmenu
ZEPHYR_HAL_INFINEON_MODULE_DIR := /workspace/modules/hal/infineon
menu "hal_infineon (/workspace/modules/hal/infineon)"
osource "$(ZEPHYR_HAL_INFINEON_KCONFIG)"
config ZEPHYR_HAL_INFINEON_MODULE
	bool
	default y

config ZEPHYR_HAL_INFINEON_MODULE_BLOBS
	bool
endmenu
ZEPHYR_HAL_INTEL_MODULE_DIR := /workspace/modules/hal/intel
menu "hal_intel (/workspace/modules/hal/intel)"
osource "/workspace/modules/hal/intel/zephyr/Kconfig"
config ZEPHYR_HAL_INTEL_MODULE
	bool
	default y
endmenu
ZEPHYR_MICROCHIP_MODULE_DIR := /workspace/modules/hal/microchip
config ZEPHYR_MICROCHIP_MODULE
	bool
	default y
ZEPHYR_HAL_NORDIC_MODULE_DIR := /workspace/modules/hal/nordic
menu "hal_nordic (/workspace/modules/hal/nordic)"
osource "$(ZEPHYR_HAL_NORDIC_KCONFIG)"
config ZEPHYR_HAL_NORDIC_MODULE
	bool
	default y

config ZEPHYR_HAL_NORDIC_MODULE_BLOBS
	bool
endmenu
ZEPHYR_NUVOTON_MODULE_DIR := /workspace/modules/hal/nuvoton
config ZEPHYR_NUVOTON_MODULE
	bool
	default y
ZEPHYR_HAL_NXP_MODULE_DIR := /workspace/modules/hal/nxp
menu "hal_nxp (/workspace/modules/hal/nxp)"
osource "$(ZEPHYR_HAL_NXP_KCONFIG)"
config ZEPHYR_HAL_NXP_MODULE
	bool
	default y

config ZEPHYR_HAL_NXP_MODULE_BLOBS
	bool
endmenu
ZEPHYR_OPENISA_MODULE_DIR := /workspace/modules/hal/openisa
config ZEPHYR_OPENISA_MODULE
	bool
	default y
ZEPHYR_QUICKLOGIC_MODULE_DIR := /workspace/modules/hal/quicklogic
config ZEPHYR_QUICKLOGIC_MODULE
	bool
	default y
ZEPHYR_HAL_RENESAS_MODULE_DIR := /workspace/modules/hal/renesas
config ZEPHYR_HAL_RENESAS_MODULE
	bool
	default y

config ZEPHYR_HAL_RENESAS_MODULE_BLOBS
	bool
ZEPHYR_HAL_RPI_PICO_MODULE_DIR := /workspace/modules/hal/rpi_pico
menu "hal_rpi_pico (/workspace/modules/hal/rpi_pico)"
osource "$(ZEPHYR_HAL_RPI_PICO_KCONFIG)"
config ZEPHYR_HAL_RPI_PICO_MODULE
	bool
	default y
endmenu
ZEPHYR_HAL_SILABS_MODULE_DIR := /workspace/modules/hal/silabs
menu "hal_silabs (/workspace/modules/hal/silabs)"
osource "$(ZEPHYR_HAL_SILABS_KCONFIG)"
config ZEPHYR_HAL_SILABS_MODULE
	bool
	default y

config ZEPHYR_HAL_SILABS_MODULE_BLOBS
	bool
endmenu
ZEPHYR_HAL_ST_MODULE_DIR := /workspace/modules/hal/st
menu "hal_st (/workspace/modules/hal/st)"
osource "$(ZEPHYR_HAL_ST_KCONFIG)"
config ZEPHYR_HAL_ST_MODULE
	bool
	default y
endmenu
ZEPHYR_HAL_STM32_MODULE_DIR := /workspace/modules/hal/stm32
config ZEPHYR_HAL_STM32_MODULE
	bool
	default y

config ZEPHYR_HAL_STM32_MODULE_BLOBS
	bool
ZEPHYR_HAL_TDK_MODULE_DIR := /workspace/modules/hal/tdk
menu "hal_tdk (/workspace/modules/hal/tdk)"
osource "$(ZEPHYR_HAL_TDK_KCONFIG)"
config ZEPHYR_HAL_TDK_MODULE
	bool
	default y
endmenu
ZEPHYR_HAL_TELINK_MODULE_DIR := /workspace/modules/hal/telink
menu "hal_telink (/workspace/modules/hal/telink)"
osource "/workspace/modules/hal/telink/Kconfig"
config ZEPHYR_HAL_TELINK_MODULE
	bool
	default y
endmenu
ZEPHYR_TI_MODULE_DIR := /workspace/modules/hal/ti
config ZEPHYR_TI_MODULE
	bool
	default y
ZEPHYR_HAL_WCH_MODULE_DIR := /workspace/modules/hal/wch
menu "hal_wch (/workspace/modules/hal/wch)"
osource "$(ZEPHYR_HAL_WCH_KCONFIG)"
config ZEPHYR_HAL_WCH_MODULE
	bool
	default y
endmenu
ZEPHYR_HAL_WURTHELEKTRONIK_MODULE_DIR := /workspace/modules/hal/wurthelektronik
config ZEPHYR_HAL_WURTHELEKTRONIK_MODULE
	bool
	default y
ZEPHYR_XTENSA_MODULE_DIR := /workspace/modules/hal/xtensa
config ZEPHYR_XTENSA_MODULE
	bool
	default y
ZEPHYR_HOSTAP_MODULE_DIR := /workspace/modules/lib/hostap
menu "hostap (/workspace/modules/lib/hostap)"
osource "$(ZEPHYR_HOSTAP_KCONFIG)"
config ZEPHYR_HOSTAP_MODULE
	bool
	default y
endmenu
ZEPHYR_LIBLC3_MODULE_DIR := /workspace/modules/lib/liblc3
menu "liblc3 (/workspace/modules/lib/liblc3)"
osource "$(ZEPHYR_LIBLC3_KCONFIG)"
config ZEPHYR_LIBLC3_MODULE
	bool
	default y
endmenu
ZEPHYR_LIBMCTP_MODULE_DIR := /workspace/modules/lib/libmctp
config ZEPHYR_LIBMCTP_MODULE
	bool
	default y
ZEPHYR_LIBMETAL_MODULE_DIR := /workspace/modules/hal/libmetal
config ZEPHYR_LIBMETAL_MODULE
	bool
	default y
ZEPHYR_LIBSBC_MODULE_DIR := /workspace/modules/lib/libsbc
menu "libsbc (/workspace/modules/lib/libsbc)"
osource "$(ZEPHYR_LIBSBC_KCONFIG)"
config ZEPHYR_LIBSBC_MODULE
	bool
	default y
endmenu
ZEPHYR_LITTLEFS_MODULE_DIR := /workspace/modules/fs/littlefs
menu "littlefs (/workspace/modules/fs/littlefs)"
osource "$(ZEPHYR_LITTLEFS_KCONFIG)"
config ZEPHYR_LITTLEFS_MODULE
	bool
	default y
endmenu
ZEPHYR_LORAMAC_NODE_MODULE_DIR := /workspace/modules/lib/loramac-node
menu "loramac-node (/workspace/modules/lib/loramac-node)"
osource "$(ZEPHYR_LORAMAC_NODE_KCONFIG)"
config ZEPHYR_LORAMAC_NODE_MODULE
	bool
	default y
endmenu
ZEPHYR_LVGL_MODULE_DIR := /workspace/modules/lib/gui/lvgl
menu "lvgl (/workspace/modules/lib/gui/lvgl)"
osource "/workspace/modules/lib/gui/lvgl/zephyr/Kconfig"
config ZEPHYR_LVGL_MODULE
	bool
	default y
endmenu
ZEPHYR_MBEDTLS_MODULE_DIR := /workspace/modules/crypto/mbedtls
menu "mbedtls (/workspace/modules/crypto/mbedtls)"
osource "$(ZEPHYR_MBEDTLS_KCONFIG)"
config ZEPHYR_MBEDTLS_MODULE
	bool
	default y
endmenu
ZEPHYR_MCUBOOT_MODULE_DIR := /workspace/bootloader/mcuboot
config ZEPHYR_MCUBOOT_MODULE
	bool
	default y
ZEPHYR_MIPI_SYS_T_MODULE_DIR := /workspace/modules/debug/mipi-sys-t
config ZEPHYR_MIPI_SYS_T_MODULE
	bool
	default y
ZEPHYR_NANOPB_MODULE_DIR := /workspace/modules/lib/nanopb
menu "nanopb (/workspace/modules/lib/nanopb)"
osource "$(ZEPHYR_NANOPB_KCONFIG)"
config ZEPHYR_NANOPB_MODULE
	bool
	default y
endmenu
ZEPHYR_NRF_WIFI_MODULE_DIR := /workspace/modules/lib/nrf_wifi
menu "nrf_wifi (/workspace/modules/lib/nrf_wifi)"
osource "$(ZEPHYR_NRF_WIFI_KCONFIG)"
config ZEPHYR_NRF_WIFI_MODULE
	bool
	default y

config ZEPHYR_NRF_WIFI_MODULE_BLOBS
	bool
endmenu
ZEPHYR_OPEN_AMP_MODULE_DIR := /workspace/modules/lib/open-amp
config ZEPHYR_OPEN_AMP_MODULE
	bool
	default y
ZEPHYR_OPENTHREAD_MODULE_DIR := /workspace/modules/lib/openthread
menu "openthread (/workspace/modules/lib/openthread)"
osource "$(ZEPHYR_OPENTHREAD_KCONFIG)"
config ZEPHYR_OPENTHREAD_MODULE
	bool
	default y
endmenu
ZEPHYR_PERCEPIO_MODULE_DIR := /workspace/modules/debug/percepio
menu "percepio (/workspace/modules/debug/percepio)"
osource "/workspace/modules/debug/percepio/zephyr/Kconfig"
config ZEPHYR_PERCEPIO_MODULE
	bool
	default y
endmenu
ZEPHYR_PICOLIBC_MODULE_DIR := /workspace/modules/lib/picolibc
menu "picolibc (/workspace/modules/lib/picolibc)"
osource "/workspace/modules/lib/picolibc/zephyr/Kconfig"
config ZEPHYR_PICOLIBC_MODULE
	bool
	default y
endmenu
ZEPHYR_SEGGER_MODULE_DIR := /workspace/modules/debug/segger
menu "segger (/workspace/modules/debug/segger)"
osource "$(ZEPHYR_SEGGER_KCONFIG)"
config ZEPHYR_SEGGER_MODULE
	bool
	default y
endmenu
ZEPHYR_TRUSTED_FIRMWARE_A_MODULE_DIR := /workspace/modules/tee/tf-a/trusted-firmware-a
menu "trusted-firmware-a (/workspace/modules/tee/tf-a/trusted-firmware-a)"
osource "$(ZEPHYR_TRUSTED_FIRMWARE_A_KCONFIG)"
config ZEPHYR_TRUSTED_FIRMWARE_A_MODULE
	bool
	default y
endmenu
ZEPHYR_TRUSTED_FIRMWARE_M_MODULE_DIR := /workspace/modules/tee/tf-m/trusted-firmware-m
menu "trusted-firmware-m (/workspace/modules/tee/tf-m/trusted-firmware-m)"
osource "$(ZEPHYR_TRUSTED_FIRMWARE_M_KCONFIG)"
config ZEPHYR_TRUSTED_FIRMWARE_M_MODULE
	bool
	default y
endmenu
ZEPHYR_UOSCORE_UEDHOC_MODULE_DIR := /workspace/modules/lib/uoscore-uedhoc
menu "uoscore-uedhoc (/workspace/modules/lib/uoscore-uedhoc)"
osource "$(ZEPHYR_UOSCORE_UEDHOC_KCONFIG)"
config ZEPHYR_UOSCORE_UEDHOC_MODULE
	bool
	default y
endmenu
ZEPHYR_ZCBOR_MODULE_DIR := /workspace/modules/lib/zcbor
menu "zcbor (/workspace/modules/lib/zcbor)"
osource "$(ZEPHYR_ZCBOR_KCONFIG)"
config ZEPHYR_ZCBOR_MODULE
	bool
	default y
endmenu
ZEPHYR_NRF_HW_MODELS_MODULE_DIR := /workspace/modules/bsim_hw_models/nrf_hw_models
config ZEPHYR_NRF_HW_MODELS_MODULE
	bool
	default y
```

## Firmware/Amon_board_firmware-STM32H743-RPi_CM4/Zephyr/AmonLander/build/Kconfig/Kconfig.shield
```kconfig
osource "/workspace/AmonLander/../boards/shields/*/Kconfig.shield"
osource "/workspace/AmonLander/boards/shields/*/Kconfig.shield"
```

## Firmware/Amon_board_firmware-STM32H743-RPi_CM4/Zephyr/AmonLander/build/Kconfig/Kconfig.shield.defconfig
```kconfig
osource "/workspace/AmonLander/../boards/shields/*/Kconfig.defconfig"
osource "/workspace/AmonLander/boards/shields/*/Kconfig.defconfig"
```

## firmware/Amon_board_firmware-MCU_SBC/Zephyr/AmonLander/build/Kconfig/boards/Kconfig
```kconfig
# Load Zephyr board Kconfig descriptions.
osource "/workspace/AmonLander/boards/arm/amon_board_v2/Kconfig"
```

## firmware/Amon_board_firmware-MCU_SBC/Zephyr/AmonLander/build/Kconfig/boards/Kconfig.amon_board_v2
```kconfig
# Load board Kconfig descriptions.
osource "/workspace/AmonLander/boards/arm/amon_board_v2/Kconfig.amon_board_v2"
```

## firmware/Amon_board_firmware-MCU_SBC/Zephyr/AmonLander/build/Kconfig/boards/Kconfig.defconfig
```kconfig
# Load Zephyr board defconfig descriptions.
osource "/workspace/AmonLander/boards/arm/amon_board_v2/Kconfig.defconfig"
```

## firmware/Amon_board_firmware-MCU_SBC/Zephyr/boards/arm/amon_board_v2/Kconfig.board
```kconfig
########################################################################################
#		
# Author: Tilen Tinta
# Date: 2025-10-04
# Description: Kconfig.bord - board properties definition
# Zephyr version: 4.2.99
#
##########################################################################################

### Custom Kconfig configuration ###
menu "RF Configuration"

    # Select numer of radio used
    choice RADIO_NUMBER
        prompt "Select number of radions"
        default RADIO_NO_2

        config RADIO_NO_1
            bool "No. radion: 1"
        
        config RADIO_NO_2
            bool "wM-No. radion: 2"

    endchoice
endmenu
```

## firmware/Amon_board_firmware-MCU_SBC/Zephyr/boards/arm/amon_board_v2/amon_board_v2_defconfig
```kconfig
##########################################################################################
#		
# Author: Tilen Tinta
# Date: 2025-10-04
# Description: amon_board_defconfig -configuration of default software elements
# Zephyr version: 4.2.99
#
##########################################################################################

### Stack setup ###
CONFIG_ARM_MPU=y
CONFIG_MAIN_STACK_SIZE=2048
CONFIG_SYSTEM_WORKQUEUE_STACK_SIZE=2048
CONFIG_CLOCK_CONTROL=y
CONFIG_ISR_STACK_SIZE=1024
CONFIG_MAIN_STACK_SIZE=1024
CONFIG_HW_STACK_PROTECTION=y
CONFIG_FPU=y


### Debugging ###
# CONFIG_THREAD_NAME=y
# CONFIG_SCHED_CPU_MASK=y
# CONFIG_THREAD_ANALYZER=y
# CONFIG_SEGGER_SYSTEMVIEW=n
# CONFIG_SIZE_OPTIMIZATIONS=y
CONFIG_TRACING=n
CONFIG_DEBUG=y
CONFIG_DEBUG_OPTIMIZATIONS=y  

CONFIG_CONSOLE=y
CONFIG_USE_SEGGER_RTT=y
CONFIG_RTT_CONSOLE=y

### MCU Pinout Drivers ###
CONFIG_PINCTRL=y
CONFIG_GPIO=y
# CONFIG_I2C=y
# CONFIG_SPI=y


CONFIG_SERIAL=y
#CONFIG_CONSOLE=y
#CONFIG_UART_CONSOLE=y


### Connected devices ###



### Log ###
CONFIG_PRINTK=y
CONFIG_LOG=y
```

## firmware/Amon_board_firmware-MCU_SBC/Zephyr/boards/arm/amon_board_v2/board.yml
```yaml
board:
  name: amon_board_v2
  full_name: Amon board v2 (mcu + RPi)
  vendor: tintat
  socs:
    - name: stm32f405xx
```
